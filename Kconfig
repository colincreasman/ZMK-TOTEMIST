## Kconfig
```kconfig
config ZMK_BEHAVIOR_LONG_PRESS
    bool "Long-press behavior"
    default y

DT_COMPAT_ZMK_BEHAVIOR_OS_SELECT := zmk,behavior-os-select
DT_COMPAT_ZMK_BEHAVIOR_OS_MODE := zmk,behavior-os-mode

config ZMK_BEHAVIOR_OS_SELECT
    bool "Host OS shortcut selection"
    default $(dt_compat_enabled,$(DT_COMPAT_ZMK_BEHAVIOR_OS_SELECT))
    select TOUCAN_OS_MODE

config ZMK_BEHAVIOR_OS_MODE
    bool "Host OS mode selection"
    default $(dt_compat_enabled,$(DT_COMPAT_ZMK_BEHAVIOR_OS_MODE))
    select TOUCAN_OS_MODE

config TOUCAN_OS_MODE
    bool
    help
      Toucan's persisted mode table: USB and each Bluetooth profile remember
      their own Mac/Windows shortcut selection. Defaults to macOS.

config TOUCAN_OS_MODE_DEFAULT_WIN
    bool "Default to Windows shortcuts"
    depends on TOUCAN_OS_MODE
```

## config/west.yml
```yaml
manifest:
  remotes:
    - name: zmkfirmware
      url-base: https://github.com/zmkfirmware
    - name: englmaxi
      url-base: https://github.com/englmaxi
    - name: urob
      url-base: https://github.com/urob
  projects:
    - name: zmk
      remote: zmkfirmware
      revision: v0.3.0
      import: app/west.yml
    # Status screen for the PandaKB dongle's OLED, on the ZMK v0.3 line.
    - name: zmk-dongle-display
      remote: englmaxi
      revision: v0.3
    # urob's modules used by his keymap, on their ZMK v0.3 tags.
    - name: zmk-adaptive-key
      remote: urob
      revision: v0.3
      path: modules/zmk/adaptive-key
    - name: zmk-auto-layer
      remote: urob
      revision: v0.3
      path: modules/zmk/auto-layer
    - name: zmk-helpers
      remote: urob
      revision: v0.3
      path: modules/zmk/helpers
    - name: zmk-leader-key
      remote: urob
      revision: v0.3
      path: modules/zmk/leader-key
    - name: zmk-tri-state
      remote: urob
      revision: v0.3
      path: modules/zmk/tri-state
    - name: zmk-unicode
      remote: urob
      revision: v0.3
      path: modules/zmk/unicode
  self:
    path: config
```
